## conf/layer.conf
```bitbake
# We have a conf and classes directory, add to BBPATH
BBPATH .= ":${LAYERDIR}"

# We have recipes-* directories, add to BBFILES
BBFILES += "${LAYERDIR}/recipes-*/*/*.bb \
	${LAYERDIR}/recipes-*/*/*.bbappend"

BBFILE_COLLECTIONS += "imx6tinto"
BBFILE_PATTERN_imx6tinto = "^${LAYERDIR}/"
BBFILE_PRIORITY_imx6tinto = "24"
```

## conf/machine/imx6dltinto.conf
```bitbake
#@TYPE: Machine
#@NAME: Tinto i.MX6DL board
#@SOC: i.MX6DL
#@DESCRIPTION: Machine configuration for Tintio project
#@MAINTAINER: kunyi chen <kunnyi_chen@ubiqconn.com>

require conf/machine/include/imx6tinto-common.inc

SOC_FAMILY = "mx6:mx6dl:imx6q:imx6solo"

PREFERRED_PROVIDER_u-boot = "u-boot-imx"
PREFERRED_PROVIDER_virtual/bootloader = "u-boot-imx"
PREFERRED_PROVIDER_virtual/kernel = "linux-imx"

UBOOT_CONFIG ??= "sd"
UBOOT_CONFIG[sd] = "tinto_config,sdcard"
UBOOT_CONFIG[mfgtool] = "tinto_config"

ENABLED_SECURE_BOOT = "yes"
```

## conf/machine/include/imx6tinto-common.inc
```bitbake
# Provides the i.MX6 Tinto project common settings

require conf/machine/include/imx-base.inc
require conf/machine/include/tune-cortexa9.inc

SERIAL_CONSOLES = "115200;ttymxc0"
UBOOT_ENTRYPOINT_mx6  = "0x12000000"
KERNEL_DEVICETREE = "imx6dl-tinto.dtb"

MACHINE_FEATURES += " pci wifi bluetooth"

IMAGE_INSTALL_append += " ap62x2-fw"
IMAGE_INSTALL_append += " brcm-patchram"
CORE_IMAGE_EXTRA_INSTALL += " u-boot-fw-utils"

KERNEL_MODULE_AUTOLOAD ?= ""
KERNEL_MODULE_AUTOLOAD += " cm36771"
KERNEL_MODULE_AUTOLOAD += " egalax_i2c"
KERNEL_MODULE_AUTOLOAD += " pn544 pn544_i2c"
KERNEL_MODULE_AUTOLOAD += " pn71xx_i2c"
```
